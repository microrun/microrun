## conf/distro/microrun.conf
```bitbake
require conf/distro/poky.conf

DISTRO = "microrun"
DISTRO_NAME = "microrun"

# Remove sysvinit and systemd
VIRTUAL-RUNTIME_init_manager = ""
VIRTUAL-RUNTIME_initscripts = ""
DISTRO_FEATURES_BACKFILL_CONSIDERED += "sysvinit"
DISTRO_FEATURES:remove = "sysvinit systemd"

# Remove unnecessary features
DISTRO_FEATURES:remove = "x11 wayland vulkan opengl bluetooth wifi nfs zeroconf 3g nfc"

# Minimal package selection
PACKAGE_CLASSES = "package_ipk"
IMAGE_FSTYPES = "cpio.gz"
```

## conf/layer.conf
```bitbake
BBPATH .= ":${LAYERDIR}"

BBFILES += "${LAYERDIR}/recipes-*/*/*.bb \
            ${LAYERDIR}/recipes-*/*/*.bbappend"

BBFILE_COLLECTIONS += "meta-custom"
BBFILE_PATTERN_meta-custom = "^${LAYERDIR}/"
BBFILE_PRIORITY_meta-custom = "6"

LAYERDEPENDS_meta-custom = "core"
LAYERSERIES_COMPAT_meta-custom = "styhead"
```
